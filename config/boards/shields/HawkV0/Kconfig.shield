## config/boards/shields/HawkV0/Kconfig.shield
```kconfig
# Copyright (c) 2020 Pete Johanson
# SPDX-License-Identifier: MIT

config SHIELD_HAWKV0_LEFT
    def_bool $(shields_list_contains,HawkV0_left)

config SHIELD_HAWKV0_RIGHT
    def_bool $(shields_list_contains,HawkV0_right)
```
